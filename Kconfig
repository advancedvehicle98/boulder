## Kconfig
```kconfig
mainmenu "Boulder configuration"


# общие настройки
menu "General settings"

config SUPPRESS_WARNING
	   bool "Suppress warning messages"
	   default n
	   help
		 Disables compilation warnings output (-w option)

config DEBUG
	   bool "Enable debug features"
	   default n
	   help
		 Enables debug compilation options and macros

config COVERAGE
	   bool "Build for coverage"
	   depends on DEBUG
	   default n
	   help
		 Produce .gcno files which can be used to create coverage reports


choice OPT_LEVEL_CHOICE
	   prompt "Optimization level"
	   optional

config OPT_O0
	   bool "-O0"

config OPT_O1
	   bool "-O1"

config OPT_O2
	   bool "-O2"

config OPT_O3
	   bool "-O3"

config OPT_Os
	   bool "-Os"

config OPT_Ofast
	   bool "-Ofast"

config OPT_Oz
	   bool "-Oz"

endchoice

config OPT_LEVEL
	   string
	   default "-O0"    if OPT-O0 || DEBUG
	   default "-O1"    if OPT_O1
	   default "-O2"    if OPT_O2
	   default "-O3"    if OPT_O3
	   default "-Os"    if OPT_Os
	   default "-Ofast" if OPT_Ofast
	   default "-Oz"    if OPT_Oz

endmenu


source "master/Kconfig"
source "slave/Kconfig"

source "scripts/kconfig/Kconfig.can"
source "scripts/kconfig/Kconfig.autopilot"
```

## master/Kconfig
```kconfig
menu "Master configuration"


choice MASTER_PLATFORM
	   prompt "Host platform"
	   help
		 This setting determines the toolchain which is used to produce the compatible binary for the master device

config MASTER_RASPBERRY_PI3
	   bool "Raspberry Pi 3"

config MASTER_NATIVE
	   bool "This host"

endchoice


source "master/kconfig/Kconfig.can"
source "master/kconfig/Kconfig.rsync"
source "master/kconfig/Kconfig.toolchain"


endmenu
```

## master/kconfig/Kconfig.can
```kconfig
menu "SocketCAN"

config MASTER_CAN_DEFAULT_IF_NAME
	   string "Network interface name"
	   default "can0"
	   help
		 Default name of the network interface to probe (can be looked up via ifconfig/ip addr)

endmenu
```

## master/kconfig/Kconfig.rsync
```kconfig
menu "Rsync"

config RSYNC_INSTALL_PATH
	   string  "Boulder installation path (via rsync)"
	   default "/opt/boulder"

config RSYNC_DEST_IP
	   string  "Rsync destination IP"
	   default "localhost"

config RSYNC_DEST_USER
	   string  "User of the target device, via whom the boulder installation is permitted"
	   default "root"

endmenu
```

## master/kconfig/Kconfig.toolchain
```kconfig
menu "Toolchain"

config MASTER_TOOLCHAIN
	   string
	   default "aarch64-linux-gnu" if MASTER_RASPBERRY_PI3
	   default ""                  if MASTER_NATIVE

endmenu
```

## scripts/kconfig/Kconfig.autopilot
```kconfig
menu "Autopilot"

config MANUAL_STEER_FLYSKY
	   bool "(TBD) Enable manual control via Flysky/IBus"
	   default y
	   help
	     (TBD) Enables manual control via Flysky remote controller on slave device. When it is enabled, the operator can override rover's autopilot by ceasing to accept motor control requests from master. However, the slave continues to broadcast telemetry messages, so that master can passively process navigation data

endmenu
```

## scripts/kconfig/Kconfig.can
```kconfig
menu "CAN interface"

source "scripts/kconfig/Kconfig.dronecan"
source "scripts/kconfig/Kconfig.canard"


choice CAN_BITRATE_CHOICE
	   prompt "CAN bitrate"

config CAN_BITRATE_5KBPS
	   bool "5 KHz"
config CAN_BITRATE_10KBPS
	   bool "10 KHz"
config CAN_BITRATE_25KBPS
	   bool "25 KHz"
config CAN_BITRATE_50KBPS
	   bool "50 KHz"
config CAN_BITRATE_125KBPS
	   bool "125 KHz"
config CAN_BITRATE_250KBPS
	   bool "250 KHz"
config CAN_BITRATE_500KBPS
	   bool "500 KHz"
config CAN_BITRATE_800KBPS
	   bool "800 KHz"	   
config CAN_BITRATE_1000KBPS
	   bool "1000 KHz"

endchoice


# невидимые параметры ===========================================

config CAN_BITRATE_KBPS
	   int
	   default 5    if CAN_BITRATE_5KBPS
	   default 10   if CAN_BITRATE_10KBPS
	   default 25   if CAN_BITRATE_25KBPS
	   default 50   if CAN_BITRATE_50KBPS
	   default 125  if CAN_BITRATE_125KBPS
	   default 250  if CAN_BITRATE_250KBPS
	   default 500  if CAN_BITRATE_500KBPS
	   default 800  if CAN_BITRATE_800KBPS
	   default 1000 if CAN_BITRATE_1000KBPS

endmenu
```

## scripts/kconfig/Kconfig.canard
```kconfig
menu "Canard"

config CANARD_MASTER_POOL_SIZE
	   int "Master memory pool size (bytes)"
	   default 24000

config CANARD_SLAVE_POOL_SIZE
	   int "Slave memory pool size (bytes)"
	   default 6000

endmenu
```

## scripts/kconfig/Kconfig.chassis
```kconfig
menu "Rover chassis" # ===============================


choice ROVER_FRAME_TYPE
	prompt "Frame type"

config ROVER_FRAME_SKID_STEERER
    bool "Skid-steerer (2 wheel pairs)"

config ROVER_FRAME_ROCKER_BOGIE
    bool "Rocker-bogie (3 wheel pairs)"

endchoice


config ROVER_FRAME_SERVO_STEERING
	bool "Enable servos for steering wheels"
	default n
	depends on ROVER_FRAME_ROCKER_BOGIE

config ROVER_FRAME_SERVO_STEERING_FOR_MIDDLE_WHEELS
    bool "Enable servo steering for middle wheels"
	default n
	depends on ROVER_FRAME_SERVO_STEERING


# невидимые параметры ---------------------------------

config INDEPENDENT_SERVO_STEERING
	bool
	default y if ROVER_FRAME_ROCKER_BOGIE
	default n


endmenu 
```

## scripts/kconfig/Kconfig.dronecan
```kconfig
menu "DroneCAN"

config DRONECAN_SLAVE_ID
	   hex "Slave ID"
	   default 0x1
	   help
		 DroneCAN ID for the slave device

config DRONECAN_MASTER_ID
	   hex "Master ID"
	   default 0x2
	   help
		 DroneCAN ID for the master device

config DRONECAN_SLAVE_NODE_NAME
	   string "Slave node name"
	   default "boulder_slave"
	   help
		 DroneCAN node name for the slave device

config DRONECAN_MASTER_NODE_NAME
	   string "Master node name"
	   default "boulder_master"
	   help
		 DroneCAN node name for the master device

config DRONECAN_FRAME_TIMEOUT
	   int "Response timeout (usec)"
	   default 1000000

endmenu
```

## slave/Kconfig
```kconfig
menu "Slave configuration"


source "slave/boards/Kconfig"
source "slave/soc/Kconfig"
source "slave/arch/Kconfig"

source "slave/kconfig/Kconfig.safety"
source "slave/kconfig/Kconfig.opts"
source "slave/kconfig/Kconfig.flash"
source "slave/kconfig/Kconfig.led"
source "slave/kconfig/Kconfig.serial"
source "slave/kconfig/Kconfig.can"
source "slave/kconfig/Kconfig.ahrs"


endmenu
```

## slave/arch/Kconfig
```kconfig
menu "CPU architecture"


# невидимые параметры -----------------------------------


# -----------------------------------------------------------

config SLAVE_ARCH_ARM_CORTEX_M3
	   def_bool SLAVE_SOC_ATMEL_SAM3X8E
	   
source "slave/arch/arm/cortex_m3/Kconfig"

config SLAVE_SLAVE_ARCH_TENSILICA_XTENSA_LX7
	   def_bool SLAVE_SOC_ESPRESSIF_ESP32_S3_WROOM_1

# -----------------------------------------------------------

config SLAVE_ARCH_PREFIX
	   string
	   default "xtensa" if SLAVE_SLAVE_ARCH_TENSILICA_XTENSA_LX7
	   default "arm"    if SLAVE_ARCH_ARM_CORTEX_M3

config SLAVE_ARCH_SUFFIX
	   string
	   default "lx7"       if SLAVE_SLAVE_ARCH_TENSILICA_XTENSA_LX7
	   default "cortex_m3" if SLAVE_ARCH_ARM_CORTEX_M3

endmenu
```

## slave/boards/Kconfig
```kconfig
menu "Target board"

choice SLAVE_BOARD
	   prompt "Board select"
	   help 
	     The name of the board for running the slave firmware

config SLAVE_BOARD_STUDICA_BLACKHAWK
	   bool "Studica Blackhawk"

config SLAVE_BOARD_ESP32_DEVKITC
	   bool "ESP32-DevKitC"

endchoice # choice SLAVE_BOARD --------------------------------


# невидимые параметры -----------------------------------

config SLAVE_BOARD_VENDOR
	   string
	   default "studica"   if SLAVE_BOARD_STUDICA_BLACKHAWK
	   default "espressif" if SLAVE_BOARD_ESP32_DEVKITC

config SLAVE_BOARD_PREFIX
	   string
	   default "blackhawk"     if SLAVE_BOARD_STUDICA_BLACKHAWK
	   default "esp32_devkitc" if SLAVE_BOARD_ESP32_DEVKITC

endmenu
```

## slave/kconfig/Kconfig.ahrs
```kconfig
menu "AHRS/IMU module" # ==============================


choice SLAVE_AHRS # -----------------------------------
	prompt "AHRS/IMU module select"
	help

config AHRS_USE_NAVX_MICRO
	bool "Kauai Labs navX-Micro"

endchoice # choice SLAVE_AHRS -------------------------


config AHRS_IFACE_INSTANCE_INDEX
	int "AHRS interface index"
	default 1
	help
	    Index of the interface used to communicate with AHRS module.
		Note: (TBD) interface index collisions are resolved in <common/defines.h>
		and an error will be generated on collision. Make sure your sensor
		and motor connections are planned ahead


# невидимые параметры ---------------------------------

config AHRS_RAW_IMU_DEVICE
	bool
	default n if AHRS_USE_NAVX_MICRO
	default y

config AHRS_VIA_I2C
	bool
	default y if AHRS_USE_NAVX_MICRO
	default n

endmenu 
```

## slave/kconfig/Kconfig.can
```kconfig
menu "CAN communication" # =======================


config SLAVE_CAN_RX_QUEUE_LEN
	   int     "Received messages queue length (bytes)"
	   default 224


endmenu 
```

## slave/kconfig/Kconfig.flash
```kconfig
menu "Flashing"


config FLASHING_UPLOAD_PORT
	   string "Upload port (/dev/<port>)"
	   default "/dev/ttyUSB0"

endmenu
```

## slave/kconfig/Kconfig.led
```kconfig
menu "LED indication"


config USE_LED_STATUS
	   bool "Enable blinking LED for status indication"
	   default y


endmenu # LED indication
```

## slave/kconfig/Kconfig.motors
```kconfig
menu "Motors" # =======================================


choice SLAVE_MOTORS_DRIVER # ---------------------------
    prompt "Motor driver select"
	help
		"This option assumes each wheel has same drivers as of now"

config MOTORS_USE_VNH5019
    bool "ST VNH5019"

endchoice # choice SLAVE_MOTOR_DRIVER -----------------


config MOTOR_1_PWM_CHANNEL
    int "PWM Channel for motor 1"
	default 2 if 
	default 1

config MOTOR_2_PWM_CHANNEL
    int "PWM Channel for motor 2"
	default 2

config MOTOR_3_PWM_CHANNEL
    int "PWM Channel for motor 3"
	default 3

config MOTOR_4_PWM_CHANNEL
    int "PWM Channel for motor 4"
	default 4

config MOTOR_5_PWM_CHANNEL
    int "PWM Channel for motor 5"
	default 5
	depends on ROVER_FRAME_SKID_STEERER

config MOTOR_6_PWM_CHANNEL
    int "PWM Channel for motor 6"
	default 6
	depends on ROVER_FRAME_SKID_STEERER


# невидимые параметры ---------------------------------

config MOTORS_VIA_PWM
    bool
    default y if MOTORS_USE_VNH5019
	default n


endmenu
```

## slave/kconfig/Kconfig.opts
```kconfig
menu "Optimization"


config SLAVE_FAST_MATH
	   bool "Enable fast math"
	   default y

config SLAVE_USE_BUFFER_QUEUE
	   bool "Use buffer_queue_t for queue handling"
	   default y

endmenu
```

## slave/kconfig/Kconfig.safety
```kconfig
menu "Safety"

config SAFETY_REDUNDANT_NULL_CHECKING
	   bool "Redundant 0/NULL check"
	   depends on ! SAFETY_COMPROMISE
	   default n
	   help
	     Enables code, that checks for zero sizes and null pointers
		 whenever possible (which is mostly useless if the API is
		 properly tested)

config SAFETY_COMPROMISE
	   bool "Compromise on non critical things"
	   default y
	   help
		 Disables verious checks. This assumes the developer is not
		 an imbecile and uses given API as intended while knowing what
		 he's doing. Actually, it disables unnecessary checks which will
		 most likely just slightly spoil the performance but not be useful
		 for anything else whatsoever

endmenu 
```

## slave/kconfig/Kconfig.toolchain
```kconfig
menu "Toolchain"


# это меню выводится, если хз какой префикс должен быть
menu "Toolchain paths"
	   visible if SLAVE_SOC_ESPRESSIF_ESP32_S3_WROOM_1

config SLAVE_TOOLCHAIN_CC_PATH
	   string "Compiler executable path"

config SLAVE_TOOLCHAIN_LD_PATH
	   string "Linker executable path (if not set, it is assumed to be the same as the compiler executable)"

endmenu


config STACK_SIZE
	   hex "Stack size"
	   default 0x200 if SLAVE_SOC_ATMEL_SAM3X8E


# невидимые параметры -----------------------------------

config SLAVE_TOOLCHAIN
	   string
	   default "arm-none-eabi" if SLAVE_SOC_ATMEL_SAM3X8E
	   default ""

endmenu
```

## slave/kconfig/soc/Kconfig.features
```kconfig
menu "SoC features" # ================================


# невидимые параметры ---------------------------------

config SOC_USE_I2C
	bool
	default y if AHRS_VIA_I2C
	default n


config SOC_USE_PWM
	bool
	default y if MOTORS_VIA_PWM
	default n


endmenu
```

## slave/kconfig/soc/Kconfig.toolchain
```kconfig
menu "Toolchain"


# это меню выводится, если хз какой префикс должен быть
menu "Toolchain paths"
	depends on SLAVE_SOC_ESPRESSIF_ESP32_S3_WROOM_1

config SLAVE_TOOLCHAIN_CC_PATH
	string "Compiler executable path"

config SLAVE_TOOLCHAIN_LD_PATH
	string "Linker executable path (if not set, it is assumed to be the same as the compiler executable)"

config SLAVE_TOOLCHAIN_ASM_PATH
	string "Assembler executable path (if not set, it is assumed to be the same as the compiler executable)"

config SLAVE_TOOLCHAIN_OBJCOPY_PATH
	string "Objcopy executable path"

endmenu


config STACK_SIZE
	hex "Stack size"
	default 0x200 if SLAVE_SOC_ATMEL_SAM3X8E


# невидимые параметры -----------------------------------

config SLAVE_TOOLCHAIN
	string
	default "arm-none-eabi" if SLAVE_SOC_ATMEL_SAM3X8E
	default ""


# ------------------------------------------------------

# костыль для библиотек для atmel
config INLINE_IS_DEFINED
	bool
	default n if SLAVE_SOC_ATMEL_SAM3X8E
	default y

endmenu
```

## slave/soc/Kconfig
```kconfig
menu "System-on-Chip"



# Kconfig-и для разных SoC ============================================

source "slave/soc/atmel/sam3x8e/Kconfig"


# невидимые параметры ============================================


# -----------------------------------------------------------

config SLAVE_SOC_ATMEL_SAM3X8E
	   def_bool SLAVE_BOARD_STUDICA_BLACKHAWK

config SLAVE_SOC_ESPRESSIF_ESP32_S3_WROOM_1
	   def_bool SLAVE_BOARD_ESP32_DEVKITC


# -----------------------------------------------------------

source "slave/kconfig/Kconfig.toolchain"


# ------------------------------------------------------

config SLAVE_SOC_VENDOR
	   string
	   default "espressif" if SLAVE_SOC_ESPRESSIF_ESP32_S3_WROOM_1
	   default "atmel"     if SLAVE_SOC_ATMEL_SAM3X8E

config SLAVE_SOC_PREFIX
	   string
	   default "esp32_s3" if SLAVE_SOC_ESPRESSIF_ESP32_S3_WROOM_1
	   default "sam3x8e"  if SLAVE_SOC_ATMEL_SAM3X8E


# ------------------------------------------------------

config SLAVE_SOC_HAS_FPU
	   bool
	   default n if SLAVE_SOC_ATMEL_SAM3X8E

endmenu
```
