## slave/soc/atmel/sam3x8e/Kconfig
```kconfig
menu "Atmel SAM3X8E"

config SAM3X8E_LINK_STACK_SECTION
	   bool "Add .stack section"
	   default n
	   help
		 Link with .stack section (use sram.ld instead of flash.ld)


config SAM3X8E_USE_CAN1
	   bool "Enable CAN1"
	   default y if SLAVE_BOARD_STUDICA_BLACKHAWK
	   default n
	   help
		 Use CAN1 interface instead of CAN0

config SAM3X8E_CAN_TX_MBOX_COUNT
	   int "Transmitter mailbox count"
	   default 2
	   help
		 Sets the number of transmitter mailboxes (from 1 to 4)
	   
config SAM3X8E_CAN_TIMEOUT_TICKS
	   int "Bus timeout on initialization (ticks)"
	   default 100000

# невидимые параметры --------------------------------------------

config SAM3X8E_CAN_TX_MBOX_COUNT_MAX
	   int
	   default 4
	   
config SAM3X8E_CAN_TX_MBOX_COUNT_MIN
	   int
	   default 1

endmenu
```
